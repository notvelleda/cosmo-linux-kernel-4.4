## drivers/misc/mediatek/aw9524/Kconfig
```kconfig
config MTK_AW9524
	tristate "MTK AW9524 Support"
	default n
	depends on LEDS_CLASS
	depends on LEDS_CLASS_MULTICOLOR
	help
	  Say Y here if you have AW9524 LED device.

	  If unsure, say Y.
```
